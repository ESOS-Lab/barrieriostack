## arch/arm/configs/exynos_eng_defconfig
```kconfig
CONFIG_SLUB_DEBUG_ON=y
CONFIG_DEBUG_RT_MUTEXES=y
CONFIG_DEBUG_LOCK_ALLOC=y
CONFIG_DEBUG_ATOMIC_SLEEP=y
CONFIG_EXYNOS_SNAPSHOT=y
```

## arch/arm/configs/exynos_user_defconfig
```kconfig
# CONFIG_SLUB_DEBUG_ON is not set
# CONFIG_DEBUG_RT_MUTEXES is not set
# CONFIG_DEBUG_LOCK_ALLOC is not set
# CONFIG_DEBUG_ATOMIC_SLEEP is not set
# CONFIG_EXYNOS_SNAPSHOT is not set
# CONFIG_CPU_THERMAL_IPA is not set
# CONFIG_CPU_THERMAL_IPA_CONTROL is not set
```

## arch/arm64/Kconfig.debug
```kconfig
menu "Kernel hacking"

source "lib/Kconfig.debug"

config FRAME_POINTER
	bool
	default y

config DEBUG_STACK_USAGE
	bool "Enable stack utilization instrumentation"
	depends on DEBUG_KERNEL
	help
	  Enables the display of the minimum amount of free stack which each
	  task has ever had available in the sysrq-T output.

config STRICT_DEVMEM
	bool "Filter access to /dev/mem"
	depends on MMU
	help
	  If this option is disabled, you allow userspace (root) access to all
	  of memory, including kernel and userspace memory. Accidental
	  access to this is obviously disastrous, but specific access can
	  be used by people debugging the kernel.

	  If this option is switched on, the /dev/mem file only allows
	  userspace access to memory mapped peripherals.

	  If in doubt, say Y.

config EARLY_PRINTK
	bool "Early printk support"
	default y
	help
	  Say Y here if you want to have an early console using the
	  earlyprintk=<name>[,<addr>][,<options>] kernel parameter. It
	  is assumed that the early console device has been initialised
	  by the boot loader prior to starting the Linux kernel.

config PID_IN_CONTEXTIDR
	bool "Write the current PID to the CONTEXTIDR register"
	help
	  Enabling this option causes the kernel to write the current PID to
	  the CONTEXTIDR register, at the expense of some additional
	  instructions during context switch. Say Y here only if you are
	  planning to use hardware trace tools with this kernel.

comment "Samsung Rooting Restriction Feature"
config SEC_RESTRICT_ROOTING
	bool "Samsung Rooting Restriction Feature"
	default n
	help
	  Restrict unauthorized executions with root permission.

config SEC_RESTRICT_SETUID
	bool "Restrict changing root privilege except allowed process"
	depends on SEC_RESTRICT_ROOTING
	default y
	help
	  Say Y here if you want to restrict functions related setuid. Only allowed
	  process can chanage ROOT privilege. Saying N will not restrict changing
	  permission.

config SEC_RESTRICT_FORK
	bool "Restrict forking process except allowed process"
	depends on SEC_RESTRICT_ROOTING
	default y
	help
	  Say Y here if you want to restrict function related fork. Process matched
	  special condition will be not forked. Saying N will not restrict forking
	  process.

config SEC_RESTRICT_ROOTING_LOG
	bool "Print restricted result to kernel log"
	depends on SEC_RESTRICT_ROOTING
	default n
	help
	   Say Y here if you want to see result of restricting SETUID or FORK. It will
	   be displayed by kernel error log. Saying N will not be displayed anything.

endmenu
```

## drivers/fingerprint/Kconfig
```kconfig
#
# Sensor  drivers configuration
#
menuconfig SENSORS_FINGERPRINT
	bool "Finger Print Sensor devices"
	help
	  Say Y here, and a list of sensors drivers will be displayed.
	  Everything that didn't fit into the other categories is here. This option
	  doesn't affect the kernel.

	  If unsure, say Y.

if SENSORS_FINGERPRINT
config SENSORS_FINGERPRINT_SYSFS
	tristate "fingerprint sensor sysfs support"
	default n
	help
	  If you say yes here you get support for
	  fingerprint sensor FINGERPRINT_SYSFS
config SENSORS_VFS7XXX
	tristate "VFS7XXX fingerprint sensor support"
	default n
	help
	  If you say yes here you get support for Validity's
	  fingerprint sensor VFS7XXX.
config SENSORS_FPRINT_SECURE
	tristate "VFS61XX fingerprint sensor support"
	default n
	help
	  If you say yes here you get support for Validity's
	  fingerprint sensor enable secure zone.
config SENSORS_ET310
	tristate "ET310 fingerprint sensor supprot"
	default n
	help
	  If you say yes here you get support for Egistec's
	  fingerprint sensor ET310.
endif
```

## drivers/media/platform/exynos/fimc-is/Kconfig
```kconfig
config VIDEO_EXYNOS_FIMC_IS
	bool "Exynos FIMC-IS (Image Subsystem) driver"
	depends on VIDEO_EXYNOS
	select MEDIA_EXYNOS
	select USE_VENDER_FEATURE if SEC_DEBUG
	default n
	help
	  This is a v4l2 driver for exynos FIMC-IS device.
config COMPANION_USE
        bool "Enable to companion"
        depends on VIDEO_EXYNOS_FIMC_IS
        default n
        help
          Enable to companion.
config CAMERA_SENSOR_8B1
        bool "Use 8B1 camera sensor"
        depends on VIDEO_EXYNOS_FIMC_IS
        default n
        help
          Use 8B1 camera sensor.
config CAMERA_SENSOR_6D1
        bool "Use 6D1 camera sensor"
        depends on VIDEO_EXYNOS_FIMC_IS
        default n
        help
          Use 6D1 camera sensor.
config USE_VENDER_FEATURE
	bool "Use vendor specific features"
        depends on VIDEO_EXYNOS_FIMC_IS
	default n
	help
	  Enable to use the vender.
```

## drivers/motor/Kconfig
```kconfig
#
#
#
menuconfig VIBETONZ
	tristate "Vibetonz"
	help
	  Say Y to enable Vibetonz support.

config MOTOR_DRV_MAX77804
	tristate "Maxim MAX77804 motor"
	default n
	depends on (MFD_MAX77804 || MFD_MAX77804K)
	help
	  If you say yes here you will get support for the
	  motor of Maxim MAX77804 PMIC.

config MOTOR_DRV_MAX77828
	tristate "Maxim MAX77828 motor"
	default n
	depends on MFD_MAX77828
	help
	  If you say yes here you will get support for the
	  motor of Maxim MAX77828 PMIC.

config MOTOR_DRV_MAX77833
    tristate "Maxim MAX77833 motor"
    default n
    depends on MFD_MAX77833
    help
      If you say yes here you will get support for the 
      motor of Maxim MAX77833 PMIC.

config MOTOR_DRV_MAX77843
	tristate "Maxim MAX77843 motor"
	default n
	depends on MFD_MAX77843
	help
	  If you say yes here you will get support for the
	  motor of Maxim MAX77843 PMIC.

config MOTOR_DRV_MAX77888
	tristate "Maxim MAX77888 motor"
	default n
	depends on MFD_MAX77888
	help
	  If you say yes here you will get support for the
	  motor of Maxim MAX77888 PMIC.

config MOTOR_DRV_MAX8997
	tristate "Maxim MAX8997 motor"
	default n
	depends on MFD_MAX8997
	help
	  If you say yes here you will get support for the
	  motor of Maxim MAX8997 PMIC.

config MOTOR_DRV_ISA1200
	tristate "ISA1200 motor"
	default n
	depends on I2C
	help
	  Say Y to enalbe the ISA1200 IC.

config MOTOR_DRV_ISA1400
	tristate "ISA1400 motor"
	default n
	depends on I2C
	help
	  Say Y to enalbe the ISA1400 IC.

config HAPTIC_ISA1200
	tristate "ISA1200 motor"
	default n
	depends on I2C
	help
	  Say Y to enalbe the ISA1200 IC.

config HAPTIC_ISA1400
	tristate "ISA1400 motor"
	default n
	depends on I2C
	help
	  Say Y to enalbe the ISA1400 IC.

config HAPTIC
	tristate "Immersion TouchSense"
	default n
	help
	  Say Y to enable Immersion TouchSense.
```

## drivers/secfilter/Kconfig
```kconfig
config SEC_NET_FILTER
       tristate "Samsung Nefilter Driver Module"
       default n
```

## drivers/sensorhub/stm/Kconfig
```kconfig
#
# sensor drivers configuration
#

config SENSORS_SSP
	tristate "Sensors ssp"
	default n
	depends on SPI
	help
	  ssp driver for sensor hub.
          If you say yes here you get ssp support for
	  sensor hub.
	  To compile this driver as a module, choose M here: the
	  module will be called ssp.

config SENSORS_SSP_STM
	tristate "Sensors ssp stm"
	default n
	depends on SPI
	help
	  ssp driver for sensor hub.
          If you say yes here you get ssp support for
	  sensor hub.
	  To compile this driver as a module, choose M here: the
	  module will be called ssp.

config SENSORS_SSP_AK09911
	tristate "Sensors ssp ak09911"
	default n
	depends on SPI
	help
	  ak09911 file for factory test and doeplus in ssp driver.
          If you say yes here you get ak09911 support for
	  factory test.
	  To compile this driver as a module, choose M here: the
	  module will be called ssp.

config SENSORS_MAX86900
	tristate "MAXIM MAX86900 HRM Sensor"
	default n
	depends on I2C && SYSFS
	help
	  If you say yes here you get support for the MAX86900
	  HRM sensor.
	  This driver can also be built as a module.  If so, the module
	  will be called max86900.

config SENSORS_MAX86902
	tristate "MAXIM MAX86902 UV HRM Sensor"
	default n
	depends on I2C
	help
	  If you say yes here you get support for the MAX86902
	  HRM sensor & uv sensor.
	  This driver can also be built as a module.  If so, the module
	  will be called MAX86902.

config SENSORS_MULTIPLE_GLASS_TYPE
	tristate "Sensors ssp multiple glass type"
	default n
	depends on SPI
	help
	  If you want to use multiple glass type, it should be set.

config SENSORS_SSP_IRDATA_FOR_CAMERA
	tristate "Sensors ssp irdata for camera"
	default n
	depends on SPI
	help
	  If you want to use irdata, it should be set.

source "drivers/sensorhub/stm/factory/Kconfig"
source "drivers/sensorhub/brcm/max_notchfilter/Kconfig"
```

## drivers/sensorhub/stm/factory/Kconfig
```kconfig
#
# sensor drivers configuration
#

config SENSORS_SSP_ATUC128L5HAR
	tristate "Sensors ssp atuc128l5har"
	default n
	depends on SPI
	help
	  atuc128l5har file for factory test in ssp driver.
          If you say yes here you get atuc128l5har support for
	  factory test.
	  To compile this driver as a module, choose M here: the
	  module will be called ssp.

config SENSORS_SSP_MPU6500
	tristate "Sensors ssp mpu6500"
	default n
	depends on SPI
	help
	  mpu6500 file for factory test in ssp driver.
          If you say yes here you get mpu6500 support for
	  factory test.
	  To compile this driver as a module, choose M here: the
	  module will be called ssp.

config SENSORS_SSP_BMP280
	tristate "Sensors ssp bmp280"
	default n
	depends on SPI
	help
	  bmp182 file for factory test in ssp driver.
          If you say yes here you get bmp280 support for
	  factory test.
	  To compile this driver as a module, choose M here: the
	  module will be called ssp.

config SENSORS_SSP_TMD4903
	tristate "Sensors ssp tmd4903"
	default n
	depends on SPI
	help
	  tmd4903 file for factory test in ssp driver.
          If you say yes here you get tmd4903 support for
	  factory test.
	  To compile this driver as a module, choose M here: the
	  module will be called ssp.

config SENSORS_SSP_MOBEAM
	tristate "Sensors ssp mobeam"
	default n
	depends on SPI
	help
	  mobeam file for ssp driver.
          If you say yes here you get mobeam support using TMG399x.
	  To compile this driver as a module, choose M here: the
	  module will be called ssp.
```

## drivers/switch/Kconfig
```kconfig
menuconfig SWITCH
	tristate "Switch class support"
	help
	  Say Y here to enable switch class support. This allows
	  monitoring switches by userspace via sysfs and uevent.

if SWITCH

config SWITCH_GPIO
	tristate "GPIO Swith support"
	depends on GPIOLIB
	help
	  Say Y here to enable GPIO based switch support.

config SWITCH_ANTENNA
        tristate "ANTENNA Swith support"
        depends on GPIOLIB
        help
          Say Y here to enable Antenna switch based switch support.

config SWITCH_ANTENNA_IF
        tristate "ANTENNA Swith control by IF detect"
        depends on GPIOLIB
        help
          Say Y here to enable Antenna switch control by IF detect.

config SWITCH_ANTENNA_EARJACK
        tristate "ANTENNA Swith control by EARJACK detect"
        depends on GPIOLIB
        help
          Say Y here to enable Antenna switch control by EARJACK detect.

config SWITCH_ANTENNA_EARJACK_IF
        tristate "ANTENNA Swith control by IF or EARJACK detect"
        depends on GPIOLIB
        help
          Say Y here to enable Antenna switch control by IF or EARJACK detect.

config SWITCH_ARIZONA
	tristate "Wolfson Arizona Switch support"
	depends on MFD_ARIZONA && INPUT && SND_SOC
	help
	  Say Y here to enable support for external accessory detection
	  with Wolfson Arizona devices. These are audio CODECs with
	  advanced audio accessory detection support.

endif # SWITCH
```

## drivers/video/exynos/decon/panels/Kconfig
```kconfig
config EXYNOS_DECON_LCD
	depends on EXYNOS_DECON
	bool "Select LCD panel driver"

config EXYNOS_DECON_MDNIE_LITE
	depends on EXYNOS_DECON_LCD
	tristate "Support MDNIE LITE"
	default n

config EXYNOS_DECON_LCD_SYSFS
	depends on EXYNOS_DECON_LCD
	tristate "Support LCD SYSFS"
	default y

config EXYNOS_DECON_LCD_MCD
	depends on EXYNOS_DECON_LCD_SYSFS
	tristate "Support MCD"
	default n

config LCD_HMT
	depends on EXYNOS_DECON_LCD
	tristate "Support HMT display"
	default n

config LCD_ALPM
	depends on EXYNOS_DECON_LCD
	tristate "Support ALPM display"
	default n

config PANEL_AID_DIMMING
	depends on EXYNOS_DECON_LCD
	tristate "Support AID Dimming"
	default n

config EXYNOS_DECON_LCD_S6E3HA0
	depends on EXYNOS_DECON_LCD && EXYNOS_MIPI_DSI
	tristate "S6E3HA0 AMOLED WQHD LCD driver(1440 x 2560)"

config EXYNOS_DECON_LCD_S6E3HA2K
	depends on EXYNOS_DECON_LCD && EXYNOS_MIPI_DSI
	tristate "S6E3HA2K AMOLED WQHD LCD driver(1440 x 2560)"

config EXYNOS_DECON_LCD_S6E3HF2
	depends on EXYNOS_DECON_LCD && EXYNOS_MIPI_DSI
	tristate "S6E3HF2 AMOLED WQXGA LCD driver(1600 x 2560)"

config EXYNOS_DECON_LCD_S6E3HF2_WQHD
	depends on EXYNOS_DECON_LCD && EXYNOS_MIPI_DSI
	tristate "S6E3HF2 AMOLED WQHD LCD driver(1440 x 2560)"

config PANEL_S6E3HF2_DYNAMIC
	depends on EXYNOS_DECON_LCD && EXYNOS_MIPI_DSI
	tristate "S6E3HF2 AMOLED SUPPORT BOTH WQHD and WQXGA RESOLUTION"

config PANEL_S6E3HA2_DYNAMIC
	depends on EXYNOS_DECON_LCD && EXYNOS_MIPI_DSI
	tristate "S6E3HA2 AMOLED SUPPORT BOTE S6E3HA0 and S6E3HA2 (1440 x 2560)"

config EXYNOS_DECON_LCD_S6E3FA0
	depends on EXYNOS_DECON_LCD && EXYNOS_MIPI_DSI
	tristate "S6E3FA0 AMOLED FHD LCD driver(1080 x 1920)"

config EXYNOS_DECON_LCD_S6E3FA2
	depends on EXYNOS_DECON_LCD && EXYNOS_MIPI_DSI
	tristate "S6E3FA2 AMOLED FHD LCD driver(1080 x 1920)"
```

## drivers/video/exynos/decon_7580/panels/Kconfig
```kconfig
config EXYNOS_DECON_DISP_LCD
	depends on EXYNOS_DECON_EXYNOS7580
	bool "Select LCD panel driver"

config EXYNOS_DECON_LCD_S6E3HA0
	depends on EXYNOS_DECON_DISP_LCD && EXYNOS_MIPI_DSI
	tristate "S6E3HA0 AMOLED WQHD LCD driver(1440 x 2560)"

config EXYNOS_DECON_LCD_S6E3HA2K
	depends on EXYNOS_DECON_DISP_LCD && EXYNOS_MIPI_DSI
	tristate "S6E3HA2K AMOLED WQHD LCD driver(1440 x 2560)"

config EXYNOS_DECON_LCD_S6E3HF2
	depends on EXYNOS_DECON_DISP_LCD && EXYNOS_MIPI_DSI
	tristate "S6E3HF2 AMOLED WQXGA LCD driver(1600 x 2560)"

config EXYNOS_DECON_LCD_S6E3FA0
	depends on EXYNOS_DECON_DISP_LCD && EXYNOS_MIPI_DSI
	tristate "S6E3FA0 AMOLED FHD LCD driver(1080 x 1920)"

config EXYNOS_DECON_LCD_S6E3FA2
	depends on EXYNOS_DECON_DISP_LCD && EXYNOS_MIPI_DSI
	tristate "S6E3FA2 AMOLED FHD LCD driver(1080 x 1920)"
```

## drivers/video/mhl/Kconfig
```kconfig
#
# mhl drivers configuration
#

menu "Mhl device support"

config SEC_MHL_SUPPORT
        bool "Enable MHL support"
        default n

config SEC_MHL_HDCP
        bool "Enable MHL HDCP"
        default n

config SEC_MHL_EDID
        bool "Enable MHL edid read"
        default n

source "drivers/video/mhl/sii8240/Kconfig"
source "drivers/video/mhl/sii8620/Kconfig"

endmenu
```

## drivers/video/mhl/sii8240/Kconfig
```kconfig
config SAMSUNG_MHL_8240
        bool "Enable Sii8240 MHL Chip Driver"
        select SEC_MHL_SUPPORT
        select SEC_MHL_HDCP
        select SEC_MHL_EDID
        default n
        ---help---
          support Sii9244 MHL Chip Driver

config MHL_VERSION
        hex "Number of MHL Version"
        depends on SAMSUNG_MHL_8240
        default 0x20
        ---help---
          MHL Version
		  For example, those device compliant
		  with MHL Specification version 2.0
		  shell set this MHL_VERSION to 0x20
```
