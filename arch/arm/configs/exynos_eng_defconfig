## kernel/galaxy_s6/arch/arm64/mach-exynos/Kconfig
```kconfig
# arch/arm/mach-exynos/Kconfig
#
# Copyright (c) 2010-2011 Samsung Electronics Co., Ltd.
#		http://www.samsung.com/
#
# Licensed under GPLv2

# Configuration options for the EXYNOS4

if ARCH_EXYNOS

menu "SAMSUNG EXYNOS SoCs Support"

config ARCH_EXYNOS5
	bool "SAMSUNG EXYNOS5"
	select HAVE_ARM_SCU if SMP
	select HAVE_SMP
	select HAVE_EXYNOS5_HSI2C if I2C
	help
	  Samsung EXYNOS5 (Cortex-A53/A57) SoC based systems

config ARCH_EXYNOS7
	bool "SAMSUNG EXYNOS7"
	select HAVE_ARM_SCU if SMP
	select HAVE_SMP
	select HAVE_EXYNOS5_HSI2C if I2C
	select PM_GENERIC_DOMAINS if PM
	help
	  Samsung EXYNOS7 (Cortex-A57/A53) SoC based systems

config SOC_EXYNOS7420
	bool "SAMSUNG EXYNOS7420"
	depends on ARCH_EXYNOS7
	select SAMSUNG_DMADEV
	select CAL_SYS_PWRDOWN
	select EXYNOS_SPI_RESET_DURING_DSTOP if CPU_IDLE
	help
	  Enable EXYNOS7420 SoC support

config SOC_EXYNOS7420_EVT_0
	bool "SAMSUNG EXYNOS7420 EVT0"
	depends on SOC_EXYNOS7420
	select CAL_SYS_PWRDOWN
	help
	  Enable EXYNOS7420 EVT0 SoC support

config EXYNOS_ASV
	bool "ENABLE EXYNOS ASV"
	default n
	depends on ARCH_EXYNOS

config EXYNOS_ASV_DYNAMIC_ABB
	bool "Enable Dynamic ABB"
	default n
	depends on EXYNOS_ASV

config EXYNOS_ASV_SUPPORT_RCC
	bool "Support RCC Table"
	default n
	depends on EXYNOS_ASV

config EXYNOS_ASV_MARGIN_TEST
	bool "Enable Margin Test"
	default n
	depends on EXYNOS_ASV

config CAL_SYS_PWRDOWN
	bool "Enable CAL for system level power down"

config EXYNOS_ATAGS
	def_bool "ATAGS based boot for EXYNOS (deprecated)"
	depends on !ARCH_MULTIPLATFORM
	depends on ATAGS
	help
	  The EXYNOS platform is moving towards being completely probed
	  through device tree. This enables support for board files using
	  the traditional ATAGS boot format.
	  Note that this option is not available for multiplatform builds.

config EXYNOS5_DYNAMIC_CPU_HOTPLUG
	bool "Dynamic CPU Hotplug support"
	depends on CPU_FREQ
	help
		Enable Dynamic CPU Hotplug

config EXYNOS_CONTENT_PATH_PROTECTION
	bool "Exynos Content Path Protection"
	depends on ARM_TRUSTZONE
	default y
	help
	  Enable content path protection of EXYNOS.

config EXYNOS5_SETUP_MIPIPHY
	bool
	depends on (VIDEO_EXYNOS_FIMC_IS || DECON_MIPI_DSI || EXYNOS_MIPI_DSI)
	default y
	help
	  Compile in common setup code for MIPI-CSIS devices

config SAMSUNG_PRODUCT_SHIP
	bool "set up for product shipping"
	default n

if EXYNOS_ATAGS

config EXYNOS_DEV_DMA
	bool
	help
	  Compile in amba device definitions for DMA controller

config EXYNOS4_DEV_AHCI
	bool
	help
	  Compile in platform device definitions for AHCI

config EXYNOS4_SETUP_FIMD0
	bool
	help
	  Common setup code for FIMD0.

config EXYNOS4_DEV_USB_OHCI
	bool
	help
	  Compile in platform device definition for USB OHCI

config EXYNOS4_SETUP_I2C1
	bool
	help
	  Common setup code for i2c bus 1.

config EXYNOS4_SETUP_I2C2
	bool
	help
	  Common setup code for i2c bus 2.

config EXYNOS4_SETUP_I2C3
	bool
	help
	  Common setup code for i2c bus 3.

config EXYNOS4_SETUP_I2C4
	bool
	help
	  Common setup code for i2c bus 4.

config EXYNOS4_SETUP_I2C5
	bool
	help
	  Common setup code for i2c bus 5.

config EXYNOS4_SETUP_I2C6
	bool
	help
	  Common setup code for i2c bus 6.

config EXYNOS4_SETUP_I2C7
	bool
	help
	  Common setup code for i2c bus 7.

config EXYNOS4_SETUP_KEYPAD
	bool
	help
	  Common setup code for keypad.

config EXYNOS4_SETUP_SDHCI
	bool
	select EXYNOS4_SETUP_SDHCI_GPIO
	help
	  Internal helper functions for EXYNOS4 based SDHCI systems.

config EXYNOS4_SETUP_SDHCI_GPIO
	bool
	help
	  Common setup code for SDHCI gpio.

config EXYNOS4_SETUP_FIMC
	bool
	help
	  Common setup code for the camera interfaces.

config EXYNOS4_SETUP_USB_PHY
	bool
	help
	  Common setup code for USB PHY controller

config EXYNOS_SETUP_SPI
	bool
	help
	  Common setup code for SPI GPIO configurations.

endif

comment "Flattened Device Tree based board for EXYNOS SoCs"

config MACH_ESPRESSO7420
	bool "SAMSUNG ESPRESSO7420 Machine using device tree"
	select ARM_AMBA
	select CLKSRC_OF
	select USE_OF
	select PINCTRL
	select PINCTRL_EXYNOS
	select S3C_DEV_RTC
	select MIGHT_HAVE_PCI
	select PCI_DOMAINS if PCI
	help
	  Machine support for Samsung EXYNOS7420 machine with device tree enabled.
	  Select this if a fdt blob is available for the EXYNOS7420 SoC based board.

config MACH_UNIVERSAL7420
	bool "SAMSUNG UNIVERSAL7420 Machine using device tree"
	select ARM_AMBA
	select CLKSRC_OF
	select USE_OF
	select PINCTRL
	select PINCTRL_EXYNOS
	select S3C_DEV_RTC
	select MIGHT_HAVE_PCI
	select PCI_DOMAINS if PCI
	help
	  Machine support for Samsung EXYNOS7420 machine with device tree enabled.
	  Select this if a fdt blob is available for the EXYNOS7420 SoC based board.
endmenu

# Reset IPs during LPA/DSTOP
config EXYNOS_SPI_RESET_DURING_DSTOP
	bool

endif

config MSM_HSIC_SYSMON
	tristate "MSM HSIC system monitor driver"
	depends on USB
	help
	  Add support for bridging with the system monitor interface of MDM
	  over HSIC. This driver allows the local system monitor to
	  communicate with the remote system monitor interface.

config MSM_HSIC_SYSMON_TEST
	tristate "MSM HSIC system monitor bridge test"
	depends on USB && MSM_HSIC_SYSMON && DEBUG_FS
	help
	  Enable the test hook for the Qualcomm system monitor HSIC driver.
	  This will create a debugfs file entry named "hsic_sysmon_test" which
	  can be read and written to send character data to the sysmon port of
	  the modem over USB.

config MSM_SUBSYSTEM_RESTART
	tristate "MSM subsystem restart"
	default n

config MSM_SYSMON_COMM
	bool "MSM System Monitor communication support"
	default y if MSM_HSIC_SYSMON && ESOC
	default n
	help
	  This option adds support for MSM System Monitor library, which
	  provides an API that may be used for notifying subsystems within
	  the SoC about other subsystems' power-up/down state-changes.

config TIMA
	bool "Enable TIMA(Trustzone based Integrity Measurement Archtecture feature"
	default n

config TIMA_LKMAUTH
	bool "Enable LKM authentication by TIMA"
	help
	  TIMA authenticates loaded kernel modules. Disable it if you don't
	  want TIMA enabled.

config TIMA_RKP
       default n
       depends on TIMA
       bool "Samsung KNOX realtime kernel protection"
       help
         this enables realtime kernel protection

config RKP_KDP
	bool "Protection for cred structure"
	depends on TIMA
	default n
	help
		Prevents unauthorized cred modification.
```

## kernel/galaxy_s6/drivers/media/platform/exynos/fimc-is2/vendor/Kconfig
```kconfig
config CAMERA_EEPROM_SUPPORT_REAR
        bool "Enable eeprom for rear cam"
        depends on VIDEO_EXYNOS_FIMC_IS
        default n
        help
          Enable eeprom for rear cam.
config CAMERA_EEPROM_SUPPORT_FRONT
        bool "Enable eeprom for front cam"
        depends on VIDEO_EXYNOS_FIMC_IS
        default n
        help
          Enable eeprom for front cam.
config COMPANION_USE
        bool "Use companion"
        depends on VIDEO_EXYNOS_FIMC_IS
        default n
        help
          Use companion.
 config COMPANION_C1_USE
        bool "Use companion C1"
        depends on COMPANION_USE
        default n
        help
          Use companion C1.
 config COMPANION_C2_USE
        bool "Use companion C2"
        depends on COMPANION_USE
        default n
        help
          Use companion C2.
config COMPANION_DCDC_USE
        bool "Use companion DCDC regulator"
        depends on COMPANION_USE
        default n
        help
          Use companion DCDC regulator.
config COMPANION_STANDBY_USE
        bool "Use companion standby"
        depends on COMPANION_USE
        default n
        help
          Use companion standby.
config OIS_USE
        bool "Use ois"
        depends on VIDEO_EXYNOS_FIMC_IS
        default n
        help
          Use ois.
config OIS_FW_UPDATE_THREAD_USE
        bool "Enable ois fw update thread"
        depends on OIS_USE
        default n
        help
          Enable ois fw update thread.
config AF_HOST_CONTROL
        bool "Enable host af control"
        depends on VIDEO_EXYNOS_FIMC_IS
        default n
        help
          Enable host af control.
```

## kernel/galaxy_s6/drivers/mhi/Kconfig
```kconfig
config MHI
	bool "MHI driver"

config MHI_RMNET_DUMP
	bool "MHI RMNET DUMP"
	default y
```

## kernel/galaxy_s6/drivers/misc/modem_v1/Kconfig
```kconfig
comment "Samsung Mobile Modem Driver (SVNET2) V1 for Memory-type Interface"
menuconfig SEC_MODEM_V1
	bool "Samsung Mobile Modem Driver (SVNET2) V1 for Memory-type Interface"
	default n
	---help---
	  Samsung Modem Interface Driver

config BOOT_DEVICE_SPI
	bool "boot device: SPI"
	depends on SEC_MODEM_V1
	default n

config LINK_DEVICE_MEMORY
	bool "Memory-type (i.e. shared memory) interface medium"
	depends on SEC_MODEM_V1
	default n

config LINK_POWER_MANAGEMENT
	bool "Power management (PM) for a link device"
	depends on SEC_MODEM_V1
	default n

config LINK_POWER_MANAGEMENT_WITH_FSM
	bool "FSM-based Power management (PM) for a link device"
	depends on SEC_MODEM_V1 && LINK_POWER_MANAGEMENT
	default n

config LINK_CONTROL_MSG_IOSM
	bool "Control Message Type: IPC Over Shared Memory (IOSM)"
	depends on SEC_MODEM_V1
	default n

config LINK_CONTROL_MSG_COMMAND
	bool "Control Message Type: Simple Command"
	depends on SEC_MODEM_V1
	default n

config LINK_DEVICE_WITH_SBD_ARCH
	bool "Link device with the SBD architecture from MIPI-LLI"
	depends on SEC_MODEM_V1
	default n

config LINK_DEVICE_NAPI
	bool "Use Rx polling (NAPI)"
	depends on SEC_MODEM_V1
	default n
	help
	NAPI is a new driver API designed to reduce CPU and interrupt load
	when the driver is receiving lots of packets.

config SEC_MODEM_DEBUG
	bool "Samsung modem interface debug"
	default n

config SEC_MODEM_DEBUGFS
	bool "Samsung modem interface debugfs support"
	depends on SEC_MODEM_DEBUG
	default n

config LINK_DEVICE_C2C
	bool "Pseudo shared-memory with chip-to-chip (C2C) interface"
	depends on SEC_MODEM_V1
	select LINK_DEVICE_MEMORY
	select LINK_POWER_MANAGEMENT
	default n

config LINK_DEVICE_LLI
	bool "link device: MIPI-LLI"
	depends on SEC_MODEM_V1
	select MIPI_LLI
	select LINK_DEVICE_MEMORY
	select LINK_POWER_MANAGEMENT
	select LINK_DEVICE_WITH_SBD_ARCH
	default n

config LINK_DEVICE_SHMEM
	bool "Real system-level shared-memory on a system bus"
	depends on SEC_MODEM_V1
	select LINK_DEVICE_MEMORY
	default n

config LINK_DEVICE_HSIC
	bool "link device: HSIC"
	depends on SEC_MODEM_V1
	default n

config LTE_MODEM_XMM7260
	bool "modem chip : IMC XMM7260"
	depends on SEC_MODEM_V1
	default n

choice
	prompt "SEC MODEM CONFIG"
	depends on SEC_MODEM_V1
	default UMTS_MODEM_SS300

config UMTS_MODEM_SS222
	bool "Samsung SS222 modem"
	select BOOT_DEVICE_SPI
	select LINK_DEVICE_C2C

config UMTS_MODEM_SH222AP
	bool "Samsung SH222AP (one-chip) modem"
	depends on SEC_MODEM_V1
	select LINK_DEVICE_SHMEM

config UMTS_MODEM_SS300
	bool "Samsung SS300 modem"
	select BOOT_DEVICE_SPI
	select LINK_DEVICE_LLI
	select LINK_POWER_MANAGEMENT_WITH_FSM
	select LINK_CONTROL_MSG_COMMAND

config UMTS_MODEM_SS333
	bool "Samsung SS333 modem"
	select BOOT_DEVICE_SPI
	select LINK_DEVICE_LLI
	select LINK_POWER_MANAGEMENT_WITH_FSM
	select LINK_CONTROL_MSG_COMMAND

config SEC_MODEM_XMM7260_CAT6
	bool "IMC XMM7260 modem"
	select LTE_MODEM_XMM7260
	select LINK_DEVICE_HSIC
	select LINK_DEVICE_LLI
	select LINK_CONTROL_MSG_IOSM
endchoice
```
