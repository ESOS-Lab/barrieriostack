## kernel/galaxy_s6/drivers/nfc/Kconfig
```kconfig
#
# Near Field Communication (NFC) devices
#

menu "Near Field Communication (NFC) devices"
	depends on NFC

config NFC_PN533
	tristate "NXP PN533 USB driver"
	depends on USB
	help
	  NXP PN533 USB driver.
	  This driver provides support for NFC NXP PN533 devices.

	  Say Y here to compile support for PN533 devices into the
	  kernel or say M to compile it as module (pn533).

config NFC_WILINK
	tristate "Texas Instruments NFC WiLink driver"
	depends on TI_ST && NFC_NCI
	help
	  This enables the NFC driver for Texas Instrument's BT/FM/GPS/NFC
	  combo devices. This makes use of shared transport line discipline
	  core driver to communicate with the NFC core of the combo chip.

	  Say Y here to compile support for Texas Instrument's NFC WiLink driver
	  into the kernel or say M to compile it as module.

config NFC_MEI_PHY
	tristate "MEI bus NFC device support"
	depends on INTEL_MEI && NFC_HCI
	help
	  This adds support to use an mei bus nfc device. Select this if you
	  will use an HCI NFC driver for an NFC chip connected behind an
	  Intel's Management Engine chip.

	  If unsure, say N.

config SEC_NFC_I2C
	bool "SEC NFC driver"
	default n
	help
	  SAMSUNG NFC Driver.
	  This driver provides support for SAMSUNG NFC products.
	  You should select your NFC product and interface.

	  Say Y here to compile support for SAMSUNG NFC driver into the
	  kernel.

config SEC_NFC
	bool "Samsung NFC driver"
	default n
	help
	  SAMSUNG NFC Driver.
	  This driver provides support for SAMSUNG NFC products.
	  You should select your NFC product and interface.

	  Say Y here to compile support for SAMSUNG NFC driver into the
	  kernel.

choice
	prompt "SEC NFC Products"
	depends on SEC_NFC
	default SEC_NFC_PRODUCT_N5
config SEC_NFC_PRODUCT_N3
	bool "N3"
config SEC_NFC_PRODUCT_N5
	bool "N5"
endchoice

choice
	prompt "SEC NFC Interface"
	depends on SEC_NFC
	default SEC_NFC_IF_I2C
config SEC_NFC_IF_UART
	bool "UART"
config SEC_NFC_IF_I2C
	bool "I2C"
config SEC_NFC_IF_I2C_GPIO
	bool "I2C-GPIO (S/W-I2C)"
	select I2C_ALGOBIT
endchoice

config SEC_NFC_CLK_REQ
	bool "SEC NFC CLK REQ"
	default n
	help
	  SAMSUNG NFC CLR REQ feature.
	  This feature provides support for SAMSUNG NFC products.
	  You should select this feature if your NFC product uses AP CLK.

	  Say Y here to compile support for SAMSUNG NFC CLK REQ feature into the
	  kernel.

config SEC_NFC_MARGINTIME
	bool "SEC NFC MARGINTIME"
	default n
	help
	  SAMSUNG SEC NFC MARGINTIME feature.
	  This feature provides support for SAMSUNG NFC products.
	  You should select this feature if your NFC product uses AVDD Cap 10uF .

	  Say Y here to compile support for SAMSUNG SEC NFC MARGINTIME feature into the
	  kernel.

config ESE_P3_LSI
	bool "Oberthur ese driver"
	depends on SPI
	default n
	help
	  Oberthur Driver.
	  This driver provides support for LSI NXP combined ESE products.
	  You should select your NFC product and interface.

config ESE_FACTORY_ONLY
	bool "Oberthur ese driver factory"
	depends on SPI
	default n
	help
	  Oberthur Driver.
	  This driver provides support for LSI NXP combined ESE products.
	  You should select your NFC product and interface.

config NFC_PN547
	bool "NXP PN547 NFC Controller Driver"
	depends on I2C
	default n
	help
	  NXP PN547 Near Field Communication controller support.
	  This option enables device driver support for the NFC.
	  It is used by many services. NFC is fully controlled using I2C
	  to communication.

config NFC_PN547_CLK_BBCLK2
	bool "NXP PN547 NFC CLOCK Controller"
	depends on NFC_PN547
	default n
	help
	  NXP PN547 Near Field Communication controller support.
	  This option enables device driver support for the NFC.
	  It is used by many services. NFC is fully controlled using I2C
	  to communicate the AP chip.

config NFC_P61
	bool "NXP PN547 NFC Controller Driver"
	depends on SPI
	default n
	help
	  NXP PN547 Near Field Communication controller support.
	  This option enables device driver support for the NFC.
	  It is used by many services. NFC is fully controlled using I2C
	  to communication

config NFC_PN547_ESE_SUPPORT
	bool "NXP PN547 ESE SUPPORT"
	depends on NFC_PN547
	default n
	help
	  NXP PN547 Near Field Communication controller support.
	  This option enables device driver support for the NFC.
	  It is used by many services. NFC is fully controlled using I2C
	  to communication

config NFC_PN547_LDO_CONTROL
	bool "PN547 NFC LDO CONTROL"
	depends on NFC_PN547
	default n
	help
	  SAMSUNG PN547 NFC LDO CONTROL feature.
	  This feature provides support for NXP PN547 products.
	  You should select this feature if your NFC product uses ldo control of i2c.

	  Say Y here to compile support for NXP PN547 LDO CONTROL feature into the
	  kernel.

config SEC_NFC_LDO_CONTROL
	bool "SEC NFC LDO CONTROL"
	depends on SEC_NFC
	default n
	help
	  SAMSUNG SEC NFC LDO CONTROL feature.
	  This feature provides support for SAMSUNG NFC products.
	  You should select this feature if your NFC product uses ldo control of i2c.

	  Say Y here to compile support for SEC NFC LDO CONTROL feature into the
	  kernel.

source "drivers/nfc/secnfc/Kconfig"
source "drivers/nfc/pn544/Kconfig"
source "drivers/nfc/microread/Kconfig"

endmenu
```

## kernel/galaxy_s6/drivers/sensors/Kconfig
```kconfig
#
# Sensor  drivers configuration
#
menuconfig SENSORS_CORE
	bool "Sensor devices"
	help
	  Say Y here, and a list of sensors drivers will be displayed.
	  Everything that didn't fit into the other categories is here. This option
	  doesn't affect the kernel.

	  If unsure, say Y.

config SENSORS_BMI055
	tristate "BMI055 Combo Sensor Driver"
	depends on I2C
	default n
	help
	  If you say yes here you get support for Bosch-Sensortec's
	  BMA254 Acceleration & Gyroscope Sensor.

config SENSORS_AK8963C
	tristate "AK8963C compass support"
	default n
	depends on I2C
	help
	  If you say yes here you get support for Asahi Kasei's
	  orientation sensor AK8963.

config SENSORS_AK09911C
	tristate "AK09911C compass support"
	default n
	depends on I2C
	help
	  If you say yes here you get support for Asahi Kasei's
	  orientation sensor AK09911C.

config SENSORS_CM3323
	depends on I2C
	tristate "CM3323 driver"
	default n
	help
	  Say Y here if you use cm3323.
	  This option enables RGB sensors using
	  Capella cm3323 device driver.

	  Say N here if you do not use cm3323.

config SENSORS_CM36653
	depends on I2C
	tristate "CM36653 driver"
	default n
	help
	  Say Y here if you use cm36653.
	  This option enables RGB sensors using
	  Capella cm36653 device driver.

	  Say N here if you do not use cm36653.

config SENSORS_TMD27723
	depends on I2C
	tristate "TMD27723 driver"
	default n
	help
	   This option enables proximity & light sensors using TMD27723 driver.

config SENSORS_TMD3782
	depends on I2C
	tristate "TMD3782 driver"
	default n
	help
	   This option enables proximity & light sensors using TMD3782 driver.

config SENSORS_ESD_DEFENCE
	depends on I2C
	tristate "ESD Defence"
	default n
	help
	  Say Y here if you use ESD defence.
	  This option enables ESD defence code.

	  Say N here if you do not use ESD defence.

config SENSORS_SX9500
	depends on I2C
	tristate "SX9500 driver"
	default n
	help
	  Say Y here if you use sx9500.
	  This option enables grip sensors using
	  SemTech sx9500 device driver.

	  Say N here if you do not use sx9500.

config SENSORS_SX9500_INIT_TOUCH_THRESHOLD
	int "SX9500 Grip sensor threshold for init touch"
	depends on SENSORS_SX9500
	default "3000"
	help
	  This value is the standard of init touch using
	  SemTech sx9500 device driver.

config SENSORS_SX9500_NORMAL_TOUCH_THRESHOLD
	int "SX9500 Grip sensor threshold for normal touch"
	depends on SENSORS_SX9500
	default "17"
	help
	  This value is the standard of normal touch using
	  SemTech sx9500 device driver.

config SENSORS_GP2A30
	depends on I2C
	tristate "GP2AP030A00F driver"
	default n
	help
	  Say Y here if you use GP2AP030A00F.
	  This option enables lproximity & light sensors using
	  SHARP GP2AP030A00F device driver.

	  Say N here if you do not use GP2AP030A00F.

config SENSORS_MAX86900
	tristate "MAXIM MAX86900 HRM Sensor"
	default n
	depends on I2C
	help
	  If you say yes here you get support for the MAX86900
	  HRM sensor.
	  This driver can also be built as a module.  If so, the module
	  will be called max86900.
```

## kernel/galaxy_s6/drivers/soc/qcom/Kconfig
```kconfig
# When adding new entries keep the list in alphabetical order

if ARCH_EXYNOS7
config MSM_IPC_ROUTER_SMD_XPRT
	depends on MSM_SMD
	depends on IPC_ROUTER
	bool "MSM SMD XPRT Layer"
	help
	  SMD Transport Layer that enables IPC Router communication within
	  a System-on-Chip(SoC). When the SMD channels become available,
	  this layer registers a transport with IPC Router and enable
	  message exchange.

config MSM_IPC_ROUTER_HSIC_XPRT
	depends on USB_QCOM_IPC_BRIDGE
	depends on IPC_ROUTER
	bool "MSM HSIC XPRT Layer"
	help
	  HSIC Transport Layer that enables off-chip communication of
	  IPC Router. When the HSIC endpoint becomes available, this layer
	  registers the transport with IPC Router and enable message
	  exchange.

config MSM_QMI_INTERFACE
	depends on IPC_ROUTER
	depends on QMI_ENCDEC
	bool "MSM QMI Interface Library"
	help
	  Library to send and receive QMI messages over IPC Router.
	  This library provides interface functions to the kernel drivers
	  to perform QMI message marshaling and transport them over IPC
	  Router.

endif # ARCH_MSM
```

## kernel/galaxy_s6/drivers/staging/samsung/Kconfig
```kconfig
# drivers/staging/samsung/Kconfig
#
# Copyright (c) 2010-2011 Samsung Electronics Co., Ltd.
#		http://www.samsung.com/
#
# Licensed under GPLv2

comment "Samsung TN Features"
config SEC_EXT
	bool "Samsung TN extension Feature"
	default y

config SEC_SYSFS
	bool "Samsung sec sysfs Feature"
	default y
	depends on SEC_EXT
	help
	  Samsung sysfs name 'sec' directory create.

config SEC_REBOOT
	bool "Samsung TM reboot extension Feature"
	default y
	depends on SEC_EXT
	help
	  Samsung TN reboot extension feature. Do additional work when reboot.

config SEC_MISC
        bool "Samsung TM Misc Feature"
        default n
        help
          Samsung TN Misc extension Feature. Do additional work when Misc.

config ARGOS
	bool "Throughput monitoring Feature"
	default n
	help
	  Check throughput and set appropriate system parameters(CPU freq, affinity, etc)

config SEC_SLOW_MODE
	bool "check whether slow cpu load is full"
	depends on SCHED_HMP && CPU_FREQ
	default n
	help
	  fast cpu can help slow cpu when only slow cpu load is busy

config SEC_DEBUG
	bool "Enable TN debugging feature"
	depends on EXYNOS_SNAPSHOT
	depends on SEC_REBOOT
	default y
	help
	  Samsung TN debugging feature.

comment "BSP Feature"
menuconfig SEC_BSP
	bool "Samsung TN BSP Feature"
	default n
	depends on SEC_EXT
	help
	  Samsung TN BSP Feature.

comment "Samsung TN logging feature"
config SEC_AVC_LOG
	default n
	bool "Enable avc audit log support" if EMBEDDED
	depends on SEC_EXT
	help
	  This option enables additional log buffer for audit log.

config SEC_DEBUG_TSP_LOG
	default n
	bool "Enable tsp log support" if EMBEDDED
	depends on SEC_EXT
	help
	  This option enables additional log buffer for tsp log.

config SEC_DEBUG_LAST_KMSG
	default y
	bool "Enable /proc/last_kmsg support" if EMBEDDED
	depends on SEC_DEBUG
	help
	  This option enables /proc/last_kmsg support.

config SEC_DEBUG_TIMA_LOG
	default y
	bool "Enable tima log support" if EMBEDDED
	depends on SEC_DEBUG
	help
	  This option enables additional log buffer for tima log.

config SEC_DEBUG_MDM_SEPERATE_CRASH
	default n
	bool "Enable modem crash with seperated command" if EMBEDDED
	depends on SEC_DEBUG
	help
	  This option enables modem crash other debug level.

comment "Samsung TN Power Management Options"
menuconfig SEC_PM
	bool "Samsung TN Power Management"
	default y
	help
	  Samsung TN Power Management.

config SEC_PM_DEBUG
	bool "Enable Samsung TN Power management debug support"
	default y
	depends on SEC_PM
	help
	  Enable Samsung TN Power management debug support.

config USER_RESET_DEBUG
	bool "USER RESET debug feature"
	default n
	help
	  This option enables debugging log for User Reset.
	  This option provides reset history log in user version.
	  This option enable proc/reset_reason support
```

## kernel/galaxy_s6/sound/soc/codecs/audience/Kconfig
```kconfig
#
# Audience earSmart driver configuration
#
menu "Audience earSmart codecs"

config SND_SOC_ES705
	tristate "earSmart eS705"
	default n
	---help---
	Valid configuration:
		SLIMBus
		SLIMBus + UART
		SLIMBus + SPI
		I2C + I2S
		SPI + I2S
		UART + I2S

config SND_SOC_ES704
	tristate "earSmart eS704"
	default n
	---help---
	Valid configuration:
		SLIMBus
		SLIMBus + UART
		SLIMBus + SPI
		I2C + I2S
		SPI + I2S
		UART + I2S

config SND_SOC_ES804
	tristate "earSmart eS804"
	default n
	---help---
	Valid configuration:
		SLIMBus
		SLIMBus + UART
		SLIMBus + SPI
		I2C + I2S
		SPI + I2S
		UART + I2S

config SND_SOC_ES_I2C
	tristate "I2C based audio processor"
	default n
	---help---
	This enabled I2C as control interface. For data
	interface I2S will be select as
	default audio data interface. SLIMBus as a data interface
	is not supported in combination with I2C as control
	interface

config SND_SOC_ES_SLIM
	tristate
	default y if SLIMBUS=y && SND_SOC_ES_I2C=n
	---help---
 	This enables SLIMBus as control interface
	as well as data interface to communicate
	with firmware. Using SLIMBus only as a control
	interface is not supported.

config SND_SOC_ESXXX_UART_FW_DOWNLOAD
	tristate "BOSKO and VS firmware download over UART"
	default n
	---help---
	Enable BOSKO and VS a firmware download over UART and
	command will remain as SLIMBus.
	This is used for faster download of Sfirmware over UART
	on higher baudrates.

config SND_SOC_ESXXX_UART_WAKEUP
	tristate "earSmart wakeup over UART"
	default n
	---help---
	Enabling this feature uses UART TX of host to
	wakeup earSmart.
	instead of wakeup gpio.
	Default wakeup interface is GPIO

config SND_SOC_3MIC_SUPPORT
	tristate "3Mics for NS"
	default n
	---help---
	Samsung 3Mic for NS
	Primary, Secondary, Tertiary Mic
	Endpoints : 131, 132, 133 and CSout is 139
	configuration : TBB/BTB

config SND_SOC_VEQ_SUPPORT
	tristate "Voice Equalizer"
	default n
	---help---
	Voice Equalizer
	Max gain, Noise estiamte adj, coefficient filter
	It depends on volume level.
	Please contact Audience HW AEs.


config SND_SOC_ESXXX_SEAMLESS_VOICE_WAKEUP
	tristate "Seamless voice wakeup"
	default n
	---help---
	Seamless voice wakeup
	PDM, 3seconds buffers, 16K, 16bit, No ASR-A
	Stage0/Stage1, oem keyword and user defined keyword
	Streaming data will be use the UART(CDEV)

config SND_SOC_ESXXX_RESTORE_STD_FW
	tristate "Restore standard firmware"
	default n
	---help---
	Restore standard fw if earSmart chip did not respond.
	sometimes, audience chip did not respond.
	Toggle the RESET_ pin
	Please use the UART interface(3Mbps)

config SND_SOC_ESXXX_VEQ_FILTER
	tristate "Enable VEQ FILTER"
	default n
	---help---
	Enable VEQ Filter.
	As a default VEQ Filter is turned off.

config SND_SOC_ESXXX_VEQ_EXTENDEDVOLUME
	tristate "Extend VEQ Volume range to eight steps"
	default n
	---help---
	Change Max Volume Index to Eight
	Otherwise default is Six Step
endmenu
```
