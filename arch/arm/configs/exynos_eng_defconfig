## drivers/video/mhl/sii8620/Kconfig
```kconfig
config SEC_MHL_SII8620
        tristate
        prompt "Silicon Image 8620 HDMI to MHL Tx"
        depends on I2C
        select SEC_MHL_SUPPORT
        select SEC_MHL_HDCP
        select SEC_MHL_EDID
        default n

config MEDIA_DATA_TUNNEL_SUPPORT
	bool
	prompt "MHL Media Data Tunneling Support"
	default n
	---help---
	  This option controls whether or not Silicon Image MHL transmitter
	  drivers include support for Media Data Tunneling (MDT).  MDT
	  support enables HID events generated by HID devices attached to
	  an MDT capable MHL sink to be passed over the MHL connection
	  to the system.

config MHL_VERSION
        hex "Number of MHL Version"
        depends on SEC_MHL_SII8620
        default 0x30
        ---help---
          MHL Version
		  For example, those device compliant
		  with MHL Specification version 3.0
		  shell set this MHL_VERSION to 0x30
```
