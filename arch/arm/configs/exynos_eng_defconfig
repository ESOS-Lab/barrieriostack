## kernel/galaxy_s6/arch/arm/mach-exynos/Kconfig
```kconfig
# arch/arm/mach-exynos/Kconfig
#
# Copyright (c) 2010-2011 Samsung Electronics Co., Ltd.
#		http://www.samsung.com/
#
# Licensed under GPLv2

# Configuration options for the EXYNOS4

if ARCH_EXYNOS

menu "SAMSUNG EXYNOS SoCs Support"

config ARCH_EXYNOS4
	bool "SAMSUNG EXYNOS4"
	default y
	select HAVE_ARM_SCU if SMP
	select HAVE_SMP
	select MIGHT_HAVE_CACHE_L2X0
	help
	  Samsung EXYNOS4 SoCs based systems

config ARCH_EXYNOS5
	bool "SAMSUNG EXYNOS5"
	select HAVE_ARM_SCU if SMP
	select HAVE_SMP
	select HAVE_EXYNOS5_HSI2C if I2C
	help
	  Samsung EXYNOS5 (Cortex-A15) SoC based systems

comment "EXYNOS SoCs"

config CPU_EXYNOS4210
	bool "SAMSUNG EXYNOS4210"
	default y
	depends on ARCH_EXYNOS4
	select ARM_CPU_SUSPEND if PM
	select PM_GENERIC_DOMAINS
	select S5P_PM if PM
	select S5P_SLEEP if PM
	select SAMSUNG_DMADEV
	help
	  Enable EXYNOS4210 CPU support

config SOC_EXYNOS4212
	bool "SAMSUNG EXYNOS4212"
	default y
	depends on ARCH_EXYNOS4
	select S5P_PM if PM
	select S5P_SLEEP if PM
	select SAMSUNG_DMADEV
	help
	  Enable EXYNOS4212 SoC support

config SOC_EXYNOS4412
	bool "SAMSUNG EXYNOS4412"
	default y
	depends on ARCH_EXYNOS4
	select SAMSUNG_DMADEV
	help
	  Enable EXYNOS4412 SoC support

config SOC_EXYNOS5250
	bool "SAMSUNG EXYNOS5250"
	default y
	depends on ARCH_EXYNOS5
	select PM_GENERIC_DOMAINS if PM
	select S5P_PM if PM
	select S5P_SLEEP if PM
	select S5P_DEV_MFC
	select SAMSUNG_DMADEV
	help
	  Enable EXYNOS5250 SoC support

config SOC_EXYNOS5422
	bool "SAMSUNG EXYNOS5422"
	default n
	depends on ARCH_EXYNOS5
	select PM_GENERIC_DOMAINS if PM
	select S5P_PM if PM
	select S5P_SLEEP if SUSPEND
	select SAMSUNG_DMADEV
	help
	  Enable EXYNOS5422 SoC support

config SOC_EXYNOS5422_REV_0
	bool "Rev 0.0"
	depends on SOC_EXYNOS5422
	help
	  This option enables for REV 0

config SOC_EXYNOS5430
	bool "SAMSUNG EXYNOS5430"
	default n
	depends on ARCH_EXYNOS5
	select PM_GENERIC_DOMAINS if PM
	select S5P_PM if PM
	select S5P_SLEEP if SUSPEND
	select SAMSUNG_DMADEV
	select EXYNOS_HSI2C_RESET_DURING_DSTOP if CPU_IDLE
	select EXYNOS_I2C_RESET_DURING_DSTOP if CPU_IDLE
	select EXYNOS_SPI_RESET_DURING_DSTOP if CPU_IDLE
	select EXYNOS_ADC_RESET_DURING_DSTOP if CPU_IDLE
	select EXYNOS_PWM_RESET_DURING_DSTOP if CPU_IDLE
	select EXYNOS_TMU_RESET_DURING_DSTOP if CPU_IDLE
	select EXYNOS_HDMI_RESET_DURING_DSTOP if CPU_IDLE
	select EXYNOS_TOP_RTC_RESET_DURING_DSTOP if CPU_IDLE
	help
	  Enable EXYNOS5430 SoC support

choice
	prompt "Revision Type"
	depends on SOC_EXYNOS5430
	help
	  This option selects cpu revision number.

config SOC_EXYNOS5430_REV_1
	bool "Rev 1.0"
endchoice

choice
	prompt "Resolution Type"
	depends on SOC_EXYNOS5430
	help
	  This option selects display resolution type.

config EXYNOS5430_WQHD
	bool "Resolution WQHD (2560 x 1440)"

config EXYNOS5430_FHD
	bool "Resolution Full HD (1920 x 1080)"

config EXYNOS5430_HD
	bool "Resolution HD (1280 x 720)"
endchoice

menu "Exynos5430 Type"
	depends on SOC_EXYNOS5430

config SOC_EXYNOS5430_L
	bool "Exynos5430 L version"
	help
	  This option enable exynos5430 lite version
endmenu

config SOC_EXYNOS5433
	bool "SAMSUNG EXYNOS5433"
	default n
	depends on ARCH_EXYNOS5
	select PM_GENERIC_DOMAINS if PM
	select S5P_PM if PM
	select S5P_SLEEP if SUSPEND
	select SAMSUNG_DMADEV
	select EXYNOS_HSI2C_RESET_DURING_DSTOP if CPU_IDLE
	select EXYNOS_SPI_RESET_DURING_DSTOP if CPU_IDLE
	select CAL_SYS_PWRDOWN
	help
	  Enable EXYNOS5433 SoC support

config CAL_SYS_PWRDOWN
	bool

choice
	prompt "Revision Type"
	depends on SOC_EXYNOS5433
	help
	  This option selects cpu revision number.

config SOC_EXYNOS5433_REV_0
	bool "Rev 0.0"

config SOC_EXYNOS5433_REV_1
	bool "Rev 1.0"

endchoice

config EXYNOS7420_BTS
	bool "Bus traffic shaper support"
	default y
	depends on SOC_EXYNOS7420
	help
	  Enable BTS (Bus traffic shaper) support

config EXYNOS5430_BTS
	bool "Bus traffic shaper support"
	default y
	depends on SOC_EXYNOS5430
	help
	  Enable BTS (Bus traffic shaper) support

config EXYNOS5433_BTS
	bool "Bus traffic shaper support"
	default y
	depends on SOC_EXYNOS5433
	help
	  Enable BTS (Bus traffic shaper) support

config EXYNOS5422_BTS
	bool "Bus traffic shaper support"
	default y
	depends on SOC_EXYNOS5422
	help
	  Enable BTS (Bus traffic shaper) support

config SOC_EXYNOS5440
	bool "SAMSUNG EXYNOS5440"
	default y
	depends on ARCH_EXYNOS5
	select ARCH_HAS_OPP
	select ARM_ARCH_TIMER
	select AUTO_ZRELADDR
	select PINCTRL
	select PINCTRL_EXYNOS5440
	select PM_OPP
	help
	  Enable EXYNOS5440 SoC support

config SOC_EXYNOS7420
	bool "SAMSUNG EXYNOS7420"
	default y
	depends on ARCH_EXYNOS5
	select PM_GENERIC_DOMAINS if PM
	select S5P_PM if PM
	select S5P_SLEEP if SUSPEND
	select ARCH_HAS_OPP
	select ARM_ARCH_TIMER
	select AUTO_ZRELADDR
	select PINCTRL
	select PINCTRL_EXYNOS7420
	select PM_OPP
	select CAL_SYS_PWRDOWN
	select SAMSUNG_DMADEV
	help
	  Enable EXYNOS7420 SoC support

choice
	prompt "Revision Type"
	depends on SOC_EXYNOS7420
	help
	  This option selects cpu revision number.

config SOC_EXYNOS7420_EVT_0
	bool "EVT 0.0"

config SOC_EXYNOS7420_EVT_1
	bool "EVT 1.0"

endchoice

menuconfig EXYNOS_CORESIGHT
	bool "Enable Coresight of exynos"
	depends on ARCH_EXYNOS
	default n

config EXYNOS_CORESIGHT_PC_INFO
	bool "Show Porgram Counter information"
	depends on EXYNOS_CORESIGHT
	default y
	help
	  Show Program Counter information When kernel panic.

config PC_ITERATION
	int "Number of Program Coutner information"
	depends on EXYNOS_CORESIGHT_PC_INFO
	range 1 10
	default 5
	help
	  Print out Program Counter as iteration value.

config EXYNOS_CORESIGHT_MAINTAIN_DBG_REG
	bool "Save/Restore Debug Registers"
	depends on EXYNOS_CORESIGHT
	default n
	help
	  When core power is down, debug registers are not mainained data
	  and OS-lock is set. To maintain data, debug registers's data must
	  save in /restore from memory. If OS-lock is set, debugging to use
	  trace32 is impossible. So OS-lock must clear when core power is up.
	  This config must enable only using iTSP program.

menuconfig EXYNOS_SNAPSHOT
	bool "Enable SnapShot of exynos for debugging"
	default y
	depends on ARCH_EXYNOS

config EXYNOS_SNAPSHOT_CALLSTACK
	int "shown callstack level"
	depends on EXYNOS_SNAPSHOT
	range 1 4
	default 4

config EXYNOS_SNAPSHOT_IRQ_EXIT
	bool "Enable debugging of interrupt exit event by kevent"
	depends on EXYNOS_SNAPSHOT
	default y

config EXYNOS_SNAPSHOT_IRQ_EXIT_THRESHOLD
	int "threshold of detection(microsecond)"
	depends on EXYNOS_SNAPSHOT_IRQ_EXIT
	range 0 1000000
	default 0

config EXYNOS_SNAPSHOT_IRQ_DISABLED
	bool "Enable debugging of interrupt disable period by kevent"
	depends on EXYNOS_SNAPSHOT
	default y

config EXYNOS_SNAPSHOT_IRQ_DISABLED_THRESHOLD
	int "threshold of detection(microsecond)"
	depends on EXYNOS_SNAPSHOT_IRQ_DISABLED
	range 0 1000000
	default 30000

config EXYNOS_SNAPSHOT_HRTIMER
	bool "Enable debugging of hrtimer by kevent"
	depends on EXYNOS_SNAPSHOT
	default n

config EXYNOS_SNAPSHOT_SOFTIRQ
	bool "Enable debugging of softirq by kevent"
	depends on EXYNOS_SNAPSHOT
	default n

config EXYNOS_SNAPSHOT_REG
	bool "Enable debugging of accessing register by kevent"
	depends on EXYNOS_SNAPSHOT
	default n

config EXYNOS_SNAPSHOT_HOOK_LOGGER
	bool "Enable hooking android platform log for ramdump"
	depends on EXYNOS_SNAPSHOT
	default y

config EXYNOS_SNAPSHOT_PANIC_REBOOT
	bool "Enable forced reboot after panic for ramdump"
	depends on EXYNOS_SNAPSHOT
	default y

config EXYNOS5_DYNAMIC_CPU_HOTPLUG
	bool "Dynamic CPU Hotplug support"
	depends on CPU_FREQ
	help
		Enable Dynamic CPU Hotplug

config HOTPLUG_THREAD_STOP
	bool "support to hotplug thread stop when LCD is on"
	depends on EXYNOS5_DYNAMIC_CPU_HOTPLUG
	help
	  The hotplug thread unnecessary when LCD is on, because
	  the dynamic hotplug not used during LCD on. This config
	  enables hotplug thread stop feature.

config EXYNOS_CONTENT_PATH_PROTECTION
	bool "Exynos Content Path Protection"
	depends on (ARM_TRUSTZONE && ARCH_EXYNOS5)
	default y
	help
	  Enable content path protection of EXYNOS.

config EXYNOS_ATAGS
	bool "ATAGS based boot for EXYNOS (deprecated)"
	depends on !ARCH_MULTIPLATFORM
	depends on ATAGS
	default y
	help
	  The EXYNOS platform is moving towards being completely probed
	  through device tree. This enables support for board files using
	  the traditional ATAGS boot format.
	  Note that this option is not available for multiplatform builds.

config EXYNOS5_SETUP_MIPIPHY
	bool
	depends on (VIDEO_EXYNOS_FIMC_IS || DECON_MIPI_DSI)
	default y
	help
	  Compile in common setup code for MIPI-CSIS devices

config ASV_MARGIN_TEST
	bool "Enable margin test"
	depends on ARM_ATAG_DTB_COMPAT
	default n
	help
	  Support to ASV voltage margin test

if EXYNOS_ATAGS

config EXYNOS_DEV_DMA
	bool
	help
	  Compile in amba device definitions for DMA controller

config EXYNOS4_DEV_AHCI
	bool
	help
	  Compile in platform device definitions for AHCI

config EXYNOS4_SETUP_FIMD0
	bool
	help
	  Common setup code for FIMD0.

config EXYNOS4_DEV_USB_OHCI
	bool
	help
	  Compile in platform device definition for USB OHCI

config EXYNOS4_SETUP_I2C1
	bool
	help
	  Common setup code for i2c bus 1.

config EXYNOS4_SETUP_I2C2
	bool
	help
	  Common setup code for i2c bus 2.

config EXYNOS4_SETUP_I2C3
	bool
	help
	  Common setup code for i2c bus 3.

config EXYNOS4_SETUP_I2C4
	bool
	help
	  Common setup code for i2c bus 4.

config EXYNOS4_SETUP_I2C5
	bool
	help
	  Common setup code for i2c bus 5.

config EXYNOS4_SETUP_I2C6
	bool
	help
	  Common setup code for i2c bus 6.

config EXYNOS4_SETUP_I2C7
	bool
	help
	  Common setup code for i2c bus 7.

config EXYNOS4_SETUP_KEYPAD
	bool
	help
	  Common setup code for keypad.

config EXYNOS4_SETUP_SDHCI
	bool
	select EXYNOS4_SETUP_SDHCI_GPIO
	help
	  Internal helper functions for EXYNOS4 based SDHCI systems.

config EXYNOS4_SETUP_SDHCI_GPIO
	bool
	help
	  Common setup code for SDHCI gpio.

config EXYNOS4_SETUP_FIMC
	bool
	help
	  Common setup code for the camera interfaces.

config EXYNOS4_SETUP_USB_PHY
	bool
	help
	  Common setup code for USB PHY controller

config EXYNOS_SETUP_SPI
	bool
	help
	  Common setup code for SPI GPIO configurations.

# machine support

if ARCH_EXYNOS4

comment "EXYNOS4210 Boards"

config MACH_SMDKC210
	bool "SMDKC210"
	select MACH_SMDKV310
	help
	  Machine support for Samsung SMDKC210

config MACH_SMDKV310
	bool "SMDKV310"
	select CPU_EXYNOS4210
	select EXYNOS4_DEV_AHCI
	select EXYNOS4_DEV_USB_OHCI
	select EXYNOS4_SETUP_FIMD0
	select EXYNOS4_SETUP_I2C1
	select EXYNOS4_SETUP_KEYPAD
	select EXYNOS4_SETUP_SDHCI
	select EXYNOS4_SETUP_USB_PHY
	select EXYNOS_DEV_DMA
	select EXYNOS_DEV_SYSMMU
	select S3C24XX_PWM
	select S3C_DEV_HSMMC
	select S3C_DEV_HSMMC1
	select S3C_DEV_HSMMC2
	select S3C_DEV_HSMMC3
	select S3C_DEV_I2C1
	select S3C_DEV_RTC
	select S3C_DEV_USB_HSOTG
	select S3C_DEV_WDT
	select S5P_DEV_FIMC0
	select S5P_DEV_FIMC1
	select S5P_DEV_FIMC2
	select S5P_DEV_FIMC3
	select S5P_DEV_FIMD0
	select S5P_DEV_G2D
	select S5P_DEV_I2C_HDMIPHY
	select S5P_DEV_JPEG
	select S5P_DEV_MFC
	select S5P_DEV_TV
	select S5P_DEV_USB_EHCI
	select SAMSUNG_DEV_BACKLIGHT
	select SAMSUNG_DEV_KEYPAD
	select SAMSUNG_DEV_PWM
	help
	  Machine support for Samsung SMDKV310

config MACH_ARMLEX4210
	bool "ARMLEX4210"
	select CPU_EXYNOS4210
	select EXYNOS4_DEV_AHCI
	select EXYNOS4_SETUP_SDHCI
	select EXYNOS_DEV_DMA
	select S3C_DEV_HSMMC
	select S3C_DEV_HSMMC2
	select S3C_DEV_HSMMC3
	select S3C_DEV_RTC
	select S3C_DEV_WDT
	help
	  Machine support for Samsung ARMLEX4210 based on EXYNOS4210

config MACH_UNIVERSAL_C210
	bool "Mobile UNIVERSAL_C210 Board"
	select CLKSRC_MMIO
	select CLKSRC_SAMSUNG_PWM
	select CPU_EXYNOS4210
	select EXYNOS4_SETUP_FIMC
	select EXYNOS4_SETUP_FIMD0
	select EXYNOS4_SETUP_I2C1
	select EXYNOS4_SETUP_I2C3
	select EXYNOS4_SETUP_I2C5
	select EXYNOS4_SETUP_SDHCI
	select EXYNOS4_SETUP_USB_PHY
	select EXYNOS_DEV_DMA
	select EXYNOS_DEV_SYSMMU
	select S3C_DEV_HSMMC
	select S3C_DEV_HSMMC2
	select S3C_DEV_HSMMC3
	select S3C_DEV_I2C1
	select S3C_DEV_I2C3
	select S3C_DEV_I2C5
	select S3C_DEV_USB_HSOTG
	select S5P_DEV_CSIS0
	select S5P_DEV_FIMC0
	select S5P_DEV_FIMC1
	select S5P_DEV_FIMC2
	select S5P_DEV_FIMC3
	select S5P_DEV_FIMD0
	select S5P_DEV_G2D
	select S5P_DEV_I2C_HDMIPHY
	select S5P_DEV_JPEG
	select S5P_DEV_MFC
	select S5P_DEV_ONENAND
	select S5P_DEV_TV
	select S5P_GPIO_INT
	select S5P_SETUP_MIPIPHY
	help
	  Machine support for Samsung Mobile Universal S5PC210 Reference
	  Board.

config MACH_NURI
	bool "Mobile NURI Board"
	select CPU_EXYNOS4210
	select EXYNOS4_SETUP_FIMC
	select EXYNOS4_SETUP_FIMD0
	select EXYNOS4_SETUP_I2C1
	select EXYNOS4_SETUP_I2C3
	select EXYNOS4_SETUP_I2C5
	select EXYNOS4_SETUP_I2C6
	select EXYNOS4_SETUP_SDHCI
	select EXYNOS4_SETUP_USB_PHY
	select EXYNOS_DEV_DMA
	select S3C_DEV_HSMMC
	select S3C_DEV_HSMMC2
	select S3C_DEV_HSMMC3
	select S3C_DEV_I2C1
	select S3C_DEV_I2C3
	select S3C_DEV_I2C5
	select S3C_DEV_I2C6
	select S3C_DEV_RTC
	select S3C_DEV_USB_HSOTG
	select S3C_DEV_WDT
	select S5P_DEV_CSIS0
	select S5P_DEV_FIMC0
	select S5P_DEV_FIMC1
	select S5P_DEV_FIMC2
	select S5P_DEV_FIMC3
	select S5P_DEV_FIMD0
	select S5P_DEV_G2D
	select S5P_DEV_JPEG
	select S5P_DEV_MFC
	select S5P_DEV_USB_EHCI
	select S5P_GPIO_INT
	select S5P_SETUP_MIPIPHY
	select SAMSUNG_DEV_ADC
	select SAMSUNG_DEV_PWM
	help
	  Machine support for Samsung Mobile NURI Board.

config MACH_ORIGEN
	bool "ORIGEN"
	select CPU_EXYNOS4210
	select EXYNOS4_DEV_USB_OHCI
	select EXYNOS4_SETUP_FIMD0
	select EXYNOS4_SETUP_SDHCI
	select EXYNOS4_SETUP_USB_PHY
	select EXYNOS_DEV_DMA
	select EXYNOS_DEV_SYSMMU
	select S3C24XX_PWM
	select S3C_DEV_HSMMC
	select S3C_DEV_HSMMC2
	select S3C_DEV_RTC
	select S3C_DEV_USB_HSOTG
	select S3C_DEV_WDT
	select S5P_DEV_FIMC0
	select S5P_DEV_FIMC1
	select S5P_DEV_FIMC2
	select S5P_DEV_FIMC3
	select S5P_DEV_FIMD0
	select S5P_DEV_G2D
	select S5P_DEV_I2C_HDMIPHY
	select S5P_DEV_JPEG
	select S5P_DEV_MFC
	select S5P_DEV_TV
	select S5P_DEV_USB_EHCI
	select SAMSUNG_DEV_BACKLIGHT
	select SAMSUNG_DEV_PWM
	help
	  Machine support for ORIGEN based on Samsung EXYNOS4210

comment "EXYNOS4212 Boards"

config MACH_SMDK4212
	bool "SMDK4212"
	select EXYNOS4_SETUP_FIMD0
	select EXYNOS4_SETUP_I2C1
	select EXYNOS4_SETUP_I2C3
	select EXYNOS4_SETUP_I2C7
	select EXYNOS4_SETUP_KEYPAD
	select EXYNOS4_SETUP_SDHCI
	select EXYNOS4_SETUP_USB_PHY
	select EXYNOS_DEV_DMA
	select EXYNOS_DEV_SYSMMU
	select S3C24XX_PWM
	select S3C_DEV_HSMMC2
	select S3C_DEV_HSMMC3
	select S3C_DEV_I2C1
	select S3C_DEV_I2C3
	select S3C_DEV_I2C7
	select S3C_DEV_RTC
	select S3C_DEV_USB_HSOTG
	select S3C_DEV_WDT
	select S5P_DEV_FIMC0
	select S5P_DEV_FIMC1
	select S5P_DEV_FIMC2
	select S5P_DEV_FIMC3
	select S5P_DEV_FIMD0
	select S5P_DEV_MFC
	select SAMSUNG_DEV_BACKLIGHT
	select SAMSUNG_DEV_KEYPAD
	select SAMSUNG_DEV_PWM
	select SOC_EXYNOS4212
	help
	  Machine support for Samsung SMDK4212

comment "EXYNOS4412 Boards"

config MACH_SMDK4412
	bool "SMDK4412"
	select MACH_SMDK4212
	select SOC_EXYNOS4412
	help
	  Machine support for Samsung SMDK4412
endif

endif

comment "Flattened Device Tree based board for EXYNOS SoCs"

config MACH_EXYNOS4_DT
	bool "Samsung Exynos4 Machine using device tree"
	depends on ARCH_EXYNOS4
	select ARM_AMBA
	select CLKSRC_OF
	select CLKSRC_SAMSUNG_PWM if CPU_EXYNOS4210
	select CPU_EXYNOS4210
	select KEYBOARD_SAMSUNG if INPUT_KEYBOARD
	select PINCTRL
	select PINCTRL_EXYNOS
	select S5P_DEV_MFC
	select USE_OF
	help
	  Machine support for Samsung Exynos4 machine with device tree enabled.
	  Select this if a fdt blob is available for the Exynos4 SoC based board.
	  Note: This is under development and not all peripherals can be supported
	  with this machine file.

config MACH_EXYNOS5_DT
	bool "SAMSUNG EXYNOS5 Machine using device tree"
	default y
	depends on ARCH_EXYNOS5
	select ARM_AMBA
	select CLKSRC_OF
	select PINCTRL
	select PINCTRL_EXYNOS
	select USE_OF
	help
	  Machine support for Samsung EXYNOS5 machine with device tree enabled.
	  Select this if a fdt blob is available for the EXYNOS5 SoC based board.

config MACH_SMDK5422
	bool "SAMSUNG SMDK5422 Machine using device tree"
	default y
	depends on ARCH_EXYNOS5 && SOC_EXYNOS5422
	select ARM_AMBA
	select CLKSRC_OF
	select PINCTRL
	select PINCTRL_EXYNOS
	select USE_OF
	help
	  Machine support for Samsung EXYNOS5422 machine with device tree enabled.
	  Select this if a fdt blob is available for the EXYNOS5422 SoC based board.

config MACH_XYREF5422
	bool "SAMSUNG XYREF5422 Machine using device tree"
	default y
	depends on ARCH_EXYNOS5 && SOC_EXYNOS5422
	select ARM_AMBA
	select CLKSRC_OF
	select PINCTRL
	select PINCTRL_EXYNOS
	select USE_OF
	help
	  Machine support for Samsung EXYNOS5422 machine with device tree enabled.
	  Select this if a fdt blob is available for the EXYNOS5422 SoC based board.

config MACH_UNIVERSAL5422
	bool "SAMSUNG UNIVERSAL5422 Machine using device tree"
	default y
	depends on ARCH_EXYNOS5 && SOC_EXYNOS5422
	select ARM_AMBA
	select CLKSRC_OF
	select PINCTRL
	select PINCTRL_EXYNOS
	select USE_OF
	help
	  Machine support for Samsung EXYNOS5422 machine with device tree enabled.
	  Select this if a fdt blob is available for the EXYNOS5422 SoC based board.

config MACH_XYREF5430
	bool "SAMSUNG XYREF5430 Machine using device tree"
	default y
	depends on ARCH_EXYNOS5 && SOC_EXYNOS5430
	select ARM_AMBA
	select CLKSRC_OF
	select PINCTRL
	select PINCTRL_EXYNOS
	select USE_OF
	help
	  Machine support for Samsung EXYNOS5430 machine with device tree enabled.
	  Select this if a fdt blob is available for the EXYNOS5430 SoC based board.

config MACH_UNIVERSAL5430
	bool "SAMSUNG UNIVERSAL5430 Machine using device tree"
	default y
	depends on ARCH_EXYNOS5 && SOC_EXYNOS5430
	select ARM_AMBA
	select CLKSRC_OF
	select PINCTRL
	select PINCTRL_EXYNOS
	select USE_OF
	help
	  Machine support for Samsung EXYNOS5430 machine with device tree enabled.
	  Select this if a fdt blob is available for the EXYNOS5430 SoC based board.

config MACH_ESPRESSO5433
	bool "SAMSUNG ESPRESSO5433 Machine using device tree"
	default y
	depends on ARCH_EXYNOS5 && SOC_EXYNOS5433
	select ARM_AMBA
	select CLKSRC_OF
	select PINCTRL
	select PINCTRL_EXYNOS
	select USE_OF
	select MIGHT_HAVE_PCI
	select PCI_DOMAINS if PCI
	help
	  Machine support for Samsung EXYNOS5433 machine with device tree enabled.
	  Select this if a fdt blob is available for the EXYNOS5433 SoC based board.

config MACH_ESPRESSO7420
	bool "SAMSUNG ESPRESSO7420 Machine using device tree"
	default y
	depends on ARCH_EXYNOS5 && SOC_EXYNOS7420
	select ARM_AMBA
	select CLKSRC_OF
	select PINCTRL
	select PINCTRL_EXYNOS
	select USE_OF
	help
	  Machine support for Samsung EXYNOS7420 machine with device tree enabled.
	  Select this if a fdt blob is available for the EXYNOS7420 SoC based board.

config MACH_UNIVERSAL5433
	bool "SAMSUNG UNIVERSAL5433 Machine using device tree"
	default y
	depends on ARCH_EXYNOS5 && SOC_EXYNOS5433
	select ARM_AMBA
	select CLKSRC_OF
	select PINCTRL
	select PINCTRL_EXYNOS
	select USE_OF
	select MIGHT_HAVE_PCI
	select PCI_DOMAINS if PCI
	help
	  Machine support for Samsung EXYNOS5433 machine with device tree enabled.
	  Select this if a fdt blob is available for the EXYNOS5433 SoC based board.

if ARCH_EXYNOS4

comment "Configuration for HSMMC 8-bit bus width"

config EXYNOS4_SDHCI_CH0_8BIT
	bool "Channel 0 with 8-bit bus"
	help
	  Support HSMMC Channel 0 8-bit bus.
	  If selected, Channel 1 is disabled.

config EXYNOS4_SDHCI_CH2_8BIT
	bool "Channel 2 with 8-bit bus"
	help
	  Support HSMMC Channel 2 8-bit bus.
	  If selected, Channel 3 is disabled.
endif

endmenu

# Reset IPs during LPA/DSTOP
config EXYNOS_HSI2C_RESET_DURING_DSTOP
	bool

config EXYNOS_I2C_RESET_DURING_DSTOP
	bool

config EXYNOS_SPI_RESET_DURING_DSTOP
	bool

config EXYNOS_ADC_RESET_DURING_DSTOP
	bool

config EXYNOS_PWM_RESET_DURING_DSTOP
	bool

config EXYNOS_TMU_RESET_DURING_DSTOP
	bool

config EXYNOS_HDMI_RESET_DURING_DSTOP
	bool

config EXYNOS_TOP_RTC_RESET_DURING_DSTOP
	bool

endif

config TIMA
	bool "Enable TIMA(Trustzone based Integrity Measurement Archtecture feature"
	default n

config TIMA_RKP
	bool "Enable RKP (Realtime Kernel Protection) TIMA feature"
	depends on TIMA
	default n

config TIMA_RKP_30
	bool "Enable RKP (Realtime Kernel Protection) TIMA 3.0 feature"
	depends on TIMA_RKP
	default y
	help
		TIMA RKP 30 features, including kernel fault fixup and optimized tima_pg_is_protected

config TIMA_RKP_L1_TABLES
	bool
	depends on TIMA_RKP
	default y
	help
	  TIMA taking over management of L1 tables.

config TIMA_RKP_L2_TABLES
	bool
	depends on TIMA_RKP
	default y
	help
	  TIMA taking over management L2 tables too.

config TIMA_RKP_L2_GROUP
	bool
	depends on TIMA_RKP_L2_TABLES
	default n
	help
	  TIMA grouping page table writes

config TIMA_RKP_LAZY_MMU
	bool
	depends on TIMA_RKP_L2_TABLES
	default	y 
	help
	  TIMA lazy MMU for L2 pages

config TIMA_IOMMU_OPT
	bool
	depends on TIMA_RKP_L2_TABLES
	default	y
	help
	  TIMA IOMMU optimization for L2 pages
	
config TIMA_KMAP_OPT
	bool
	depends on TIMA_RKP_L2_TABLES
	default	y
	help
	  TIMA KMAP optimization for L2 pages

config TIMA_DALVIKHEAP_OPT
	bool
	depends on TIMA_RKP_L2_TABLES
	default	y 
	help
	  TIMA DALVIK HEAP optimization for L2 pages

config TIMA_RKP_DEBUG
	bool
	depends on TIMA_RKP
	default n
	help
	  not workable in  K3G right now, no code ported in for this part.TIMA debug infrastructure.

config TIMA_TEST_INFRA
	tristate "Testing infrastructure for TIMA"
	default n
	help
	  Kernel bits of the TIMA test infrastructure
```
